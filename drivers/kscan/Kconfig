## drivers/kscan/Kconfig
```kconfig
# Copyright (c) 2020 The ZMK Contributors
# SPDX-License-Identifier: MIT

DT_COMPAT_ZMK_KSCAN_BLACKOUT := zmk,kscan-blackout

if KSCAN

config ZMK_KSCAN_BLACKOUT_DRIVER
    bool
    default $(dt_compat_enabled,$(DT_COMPAT_ZMK_KSCAN_BLACKOUT))

if ZMK_KSCAN_BLACKOUT_DRIVER

config ZMK_KSCAN_BLACKOUT_INIT_PRIORITY
    int "Init Priority for the blackout kscan driver"
    default 95

endif

endif # KSCAN
```

## dts/bindings/kscan/zmk,kscan-blackout.yaml
```yaml
description: |
  Allows KSCAN devices into one virtual device

compatible: "zmk,kscan-blackout"

properties:
  label:
    type: string
    required: false
    deprecated: true
```
